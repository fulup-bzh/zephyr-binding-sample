## CMakeLists.txt
```
# SPDX-License-Identifier: Apache-2.0

cmake_minimum_required(VERSION 3.20.0)

find_package(Zephyr REQUIRED HINTS $ENV{ZEPHYR_BASE})
project(binding_test)

target_sources(app PRIVATE src/main.c src/dhcp.c)

# Fulup note: module specific include declaration should be within rp-lib & libafb repo not within application
include_directories(${CMAKE_SOURCE_DIR}/../modules/lib/rp-lib-utils/src)
include_directories(${CMAKE_SOURCE_DIR}/../modules/lib/afb-libafb/src/libafb)
```

## Kconfig
```
# AFB Binder configuration
# SPDX-License-Identifier: Apache-2.0

# This loads Zephyr base shield defconfigs
source "../zephyr/Kconfig"

config ZEPHYR_AFB_BINDING_MODULE
	bool

config ZEPHYR_AFB_LIBAFB_MODULE
	bool

config ZEPHYR_RP_LIB_UTILS_MODULE
	bool

config AFB_BINDER
	bool "AFB Binder Support"
	default n
	select CONFIG_POSIX_API
	select CONFIG_PTHREAD_IPC
	help
	  This option enables the AFB Binder library
```

## west.yml
```
manifest:

  remotes:
    - name: redpesk-core
      url-base: https://github.com/redpesk-core
    - name: iotbzh-internal
      url-base: http://git.ovh.iot/redpesk/redpesk-core/

  projects:
    - name: zephyr
      url: https://github.com/zephyrproject-rtos/zephyr
      revision: main
      path: zephyr
      west-commands: scripts/west-commands.yml
      import:
        name-allowlist:
          - cmsis
          - hal_nxp

    - name: afb-binding
      remote: iotbzh-internal
      repo-path: afb-binding
      path: modules/lib/afb-binding
      revision: "@jobol/zef"
      groups:
        - afb-binder

    - name: afb-libafb
      remote: iotbzh-internal
      repo-path: afb-libafb
      path: modules/lib/afb-libafb
      revision: "@jobol/zef"
      groups:
        - afb-binder

    - name: rp-lib-utils
      remote: iotbzh-internal
      repo-path: rp-lib-utils
      path: modules/lib/rp-lib-utils
      revision: "@jobol/zef"
      groups:
        - afb-binder

  self:
    path: binding-sample
```

## prj.conf
```kconfig
# nothing here

CONFIG_AFB_BINDER=y
CONFIG_POSIX_API=y
CONFIG_POSIX_THREADS=y
CONFIG_THREAD_STACK_INFO=y
CONFIG_DYNAMIC_THREAD=y
CONFIG_DYNAMIC_THREAD_POOL_SIZE=4
CONFIG_DYNAMIC_THREAD_STACK_SIZE=2048

CONFIG_NETWORKING=y
CONFIG_NET_IPV6=n
CONFIG_NET_IPV4=y
CONFIG_NET_ARP=y
CONFIG_NET_UDP=y
CONFIG_NET_TCP=y
CONFIG_NET_DHCPV4=y
CONFIG_NET_DHCPV4_OPTION_CALLBACKS=y
CONFIG_DNS_RESOLVER=y
CONFIG_NET_IPV4_AUTO=n

CONFIG_NET_PKT_RX_COUNT=16
CONFIG_NET_PKT_TX_COUNT=16
CONFIG_NET_BUF_RX_COUNT=80
CONFIG_NET_BUF_TX_COUNT=80

CONFIG_NET_L2_ETHERNET=y
CONFIG_NET_SOCKETS=y
CONFIG_NET_SOCKETS_SERVICE_THREAD_PRIO=-1
CONFIG_NET_SOCKETS_POLL_MAX=20
CONFIG_ZVFS_OPEN_MAX=20

CONFIG_MAIN_STACK_SIZE=2048
CONFIG_INIT_STACKS=y

CONFIG_NET_MGMT=y
CONFIG_NET_MGMT_EVENT=y


CONFIG_LOG=y
CONFIG_NET_LOG=y
#CONFIG_ETHERNET_LOG_LEVEL_DBG=y
#CONFIG_NET_SOCKETS_LOG_LEVEL_DBG=y
#CONFIG_NET_CONN_LOG_LEVEL_DBG=y
#CONFIG_NET_CONTEXT_LOG_LEVEL_DBG=y


CONFIG_NET_HOSTNAME_ENABLE=y
CONFIG_NET_HOSTNAME="zefpesk"

CONFIG_ZVFS=y
CONFIG_ZVFS_EVENTFD=y
CONFIG_ZVFS_EVENTFD_MAX=4
```

## src/main.c
```c
/*
 * Copyright (c) 2012-2014 Wind River Systems, Inc.
 *
 * SPDX-License-Identifier: Apache-2.0
 */

#include <stdio.h>
#include <zephyr/kernel.h>

#include <sys/rp-verbose.h>
#include <afb-v4.h>
#include <afb-apis.h>

/**********************************************************************/
/**********************************************************************/
/**********************************************************************/
/* section poubelle */
/**********************************************************************/
/**********************************************************************/
/**********************************************************************/
/*************

void mat_process(void *closure, struct afb_req_common *req)
{
	printf ("COUCOU\n");
	afb_req_common_reply(req, 0, 0, NULL);
}

struct afb_api_itf imat = 
	{
		.process = mat_process
	};

void add_mat_mon_api_test_xxx()
{
	int rc;
	rc = afb_apiset_add(zafb_all_apis, "mat", (struct afb_api_item){ .closure = NULL, .itf = &imat, .group = NULL });
	printf ("add_mat_mon_api_test_xxx: %d\n", rc);
}

*/

/**********************************************************************/
/**********************************************************************/
/**********************************************************************/
/* section binding tuto 1 */
/**********************************************************************/
/**********************************************************************/
/**********************************************************************/

void hello(afb_req_t req, unsigned nparams, afb_data_t const *params)
{
	int retcod;
	const char *who = "World"; /* default value */
	char hello[100];
	afb_data_t reply, name;

	/* some output for tracking the process */
	AFB_REQ_DEBUG(req, "Hi debugger!");

	/* extract the name of the caller */
	retcod = afb_req_param_convert(req, 0, AFB_PREDEFINED_TYPE_STRINGZ, &name);
	who = retcod == 0 ? afb_data_ro_pointer(name) : "World" /* default value */;
	AFB_REQ_NOTICE(req, "Hi observer! I'm %s and I received hello from %s", afb_req_get_called_api(req), who);

	/* create the reply string */
	retcod = snprintf(hello, sizeof hello, "Hello %s!", who);
	if (retcod >= (int)sizeof hello) {
		AFB_REQ_WARNING(req, "name too long, truncated!");
		retcod = (int)sizeof hello - 1;
		hello[retcod] = 0;
	}

	/* make the reply string */
	afb_create_data_copy(&reply, AFB_PREDEFINED_TYPE_STRINGZ, hello, (size_t)(retcod + 1 /*with last zero*/));
	afb_req_reply(req, 0, 1, &reply);
}

const afb_verb_t tuto_desc_verbs[] = {
	{ .verb="hello", .callback=hello },
	{ .verb=NULL }
};


static int tuto_mainctl(afb_api_t api, afb_ctlid_t ctlid, afb_ctlarg_t ctlarg, void *userdata)
{
	switch (ctlid) {
	case afb_ctlid_Root_Entry:
		AFB_API_NOTICE(api, "unexpected root entry");
		break;

	case afb_ctlid_Pre_Init:
		AFB_API_NOTICE(api, "hello binding comes to live");
		AFB_API_NOTICE(api, "hello binding is %s", ctlarg->pre_init.path ?: "<null>");
		AFB_API_NOTICE(api, "hello binding's uid is %s", ctlarg->pre_init.uid);
		AFB_API_NOTICE(api, "hello binding's config is %p", ctlarg->pre_init.config);

#if defined(PREINIT_PROVIDE_CLASS)
		afb_api_provide_class(api, PREINIT_PROVIDE_CLASS);
#endif
#if defined(PREINIT_REQUIRE_CLASS)
		afb_api_require_class(api, PREINIT_REQUIRE_CLASS);
#endif
		break;

	case afb_ctlid_Init:
		AFB_API_NOTICE(api, "hello binding starting");
#if defined(INIT_REQUIRE_API)
		afb_api_require_api(api, INIT_REQUIRE_API, 1);
#endif
		break;

	case afb_ctlid_Class_Ready:
		AFB_API_NOTICE(api, "hello binding has classes ready");
		break;

	case afb_ctlid_Orphan_Event:
		AFB_API_NOTICE(api, "received orphan event %s", ctlarg->orphan_event.name);
		break;

	case afb_ctlid_Exiting:
		AFB_API_NOTICE(api, "exiting code %d", ctlarg->exiting.code);
		break;

	default:
		break;
	}
	return 0;
}

const afb_binding_t tuto0_desc_api = {
	.api = "tuto0",
	.mainctl = tuto_mainctl,
	.verbs = tuto_desc_verbs
};

const afb_binding_t tuto1_desc_api = {
	.api = "tuto1",
	.mainctl = tuto_mainctl,
	.verbs = tuto_desc_verbs
};

/**********************************************************************/
/**********************************************************************/
/**********************************************************************/
/* section interface d'integration */
/**********************************************************************/
/**********************************************************************/
/**********************************************************************/
struct afb_apiset *zafb_all_apis;

struct afb_apiset *zafb_apiset()
{
	if (zafb_all_apis == NULL) {
		zafb_all_apis = afb_apiset_create(NULL, 0);
		printf ("zafb_apiset built %p\n", zafb_all_apis);
	}
	return zafb_all_apis;
}	

int __zafb_binding_add_preinit__(afb_api_t api, void *closure)
{
	int rc;
	const afb_binding_t *binding = closure;
	union afb_ctlarg ctlarg;

printf ("..1..\n");

	/* record the description */
	afb_api_v4_set_userdata(api, binding->userdata);
	afb_api_v4_set_mainctl(api, binding->mainctl);
	afb_api_v4_set_verbs(api, binding->verbs);
	rc = 0;
	if (binding->provide_class)
		rc =  afb_api_v4_class_provide(api, binding->provide_class);
	if (!rc && binding->require_class)
		rc =  afb_api_v4_class_require(api, binding->require_class);
	if (!rc && binding->require_api)
		rc =  afb_api_v4_require_api(api, binding->require_api, 0);

printf ("..2.. %d\n", rc);

	if (rc >= 0 && binding->mainctl) {
		/* call the pre init routine safely */
		memset(&ctlarg, 0, sizeof ctlarg);
		ctlarg.pre_init.path = NULL;
		ctlarg.pre_init.uid = binding->api;
		ctlarg.pre_init.config = NULL;
		rc = afb_api_v4_safe_ctlproc(api, binding->mainctl, afb_ctlid_Pre_Init, &ctlarg);
	}

	/* seal after init allows the pre init to add things */
	if (rc >= 0)
		afb_api_v4_seal(api);
	return rc;
}

int zafb_binding_add(afb_api_t *api, const afb_binding_t *binding)
{
	int rc = afb_api_v4_create(
		api,
		zafb_apiset(), zafb_apiset(),
		binding->api, Afb_String_Const,
		binding->info, Afb_String_Const,
		binding->noconcurrency,
		__zafb_binding_add_preinit__, (void*)binding,
		NULL, Afb_String_Const);
	printf ("zafb_binding_add %d %p\n", rc, *api);
	return rc;
}

int zafb_start()
{
	return afb_apiset_start_all_services(zafb_apiset());
}

/**********************************************************************/
/**********************************************************************/
/**********************************************************************/
/* section interface d'integration */
/**********************************************************************/
/**********************************************************************/
/**********************************************************************/

int sent;
_Atomic int received;

afb_api_t tuto0, tuto1;

void onrep(
	void *closure,
	int status,
	unsigned nreplies,
	afb_data_t const replies[],
	afb_api_t api
) {
	int rc;
	unsigned idx;
	afb_data_t str;

	printf ("onrep. %d %d %p\n", status, nreplies, (void*)x_thread_self());
	AFB_API_NOTICE(api, "reply received");

	if (AFB_IS_ERRNO(status))
		AFB_API_NOTICE(api, "got error %d", status);

	for (idx = 0 ; idx < nreplies ; idx++) {
		rc = afb_data_convert(replies[idx], AFB_PREDEFINED_TYPE_STRINGZ, &str);
		if (rc >= 0) {
			AFB_API_NOTICE(api, "got data %u as string %s", idx, (const char *)afb_data_ro_pointer(str));
			afb_data_unref(str);
		}
		else
			AFB_API_NOTICE(api, "got data %u of type %s", idx, afb_type_name(afb_data_type(str)));
	}

	if (++received == sent) {
		AFB_API_NOTICE(api, "leaving");
//		afb_sched_exit(0, NULL, NULL, received);
	}
}

void docall(afb_api_t api)
{
	int rc;
	afb_data_t arg;

	/* make the reply string */
	rc = afb_create_data_raw(&arg, AFB_PREDEFINED_TYPE_STRINGZ, "zephyr", 7, NULL, NULL);
	printf ("docall. %d %p\n", rc, arg);

	afb_api_call(api, sent & 1 ? "tuto0" : "tuto1", "hello", 1, &arg, onrep, NULL);
}


void start(int signum, void* arg)
{
	int rc;

	rc = zafb_binding_add(&tuto0, &tuto0_desc_api);
	printf ("binding-add.0 %d %p\n", rc, tuto0);

	rc = zafb_binding_add(&tuto1, &tuto1_desc_api);
	printf ("binding-add.1 %d %p\n", rc, tuto1);

	rc = afb_api_rpc_add_server("tcp:*:1234/tuto0", zafb_apiset(), zafb_apiset());
	printf ("api-rpc-add-server %d\n", rc);

	rc = zafb_start();
	printf ("start. %d\n", rc);

	for (rc = 0 ; rc < 1 ; rc++) {
		sent++;
		docall(sent & 1 ? tuto1 : tuto0);
	}

	printf ("end of start\n");
}

static void run_afb()
{
	int rc;

	printf ("STARTING AFB\n");
	rp_set_logmask(-1);

	rc = afb_ev_mgr_init();
	printf ("ev-mgr-init status %d\n", rc);

	rc = afb_sched_start(1, 1, 30, start, NULL);
	printf ("sched-start status %d\n", rc);

	printf ("ENDING AFB\n");
}

#define RUN_IN_THREAD 0
#if RUN_IN_THREAD
static void *start_afb(void* arg)
{
	run_afb();
	return NULL;
}
static void run_afb_in_separate_thread()
{
	int rc;
	x_thread_t tid;
	printf ("starting of afb thread...\n");
	rc = x_thread_create(&tid, start_afb, NULL, 1);
	printf ("start of afb thread %d\n", rc);
}
#define run_afb run_afb_in_separate_thread
#endif

extern void init_dhcp();

int main(void)
{
	printf ("COUCOU\n");

	init_dhcp();

	run_afb();
	printf ("*** END ***\n");

	return 0;
}
```

## src/dhcp.c
```c
/* copied from zephyr/samples/net/dhcpv4_client/src/main.c (zephyr 3.7.0) */

/* Networking DHCPv4 client */

/*
 * Copyright (c) 2017 ARM Ltd.
 * Copyright (c) 2016 Intel Corporation.
 *
 * SPDX-License-Identifier: Apache-2.0
 */

#include <zephyr/logging/log.h>
LOG_MODULE_REGISTER(net_dhcpv4_client_sample, LOG_LEVEL_DBG);

#include <zephyr/kernel.h>
#include <zephyr/linker/sections.h>
#include <errno.h>
#include <stdio.h>

#include <zephyr/net/net_if.h>
#include <zephyr/net/net_core.h>
#include <zephyr/net/net_context.h>
#include <zephyr/net/net_mgmt.h>

#define DHCP_OPTION_NTP (42)

static uint8_t ntp_server[4];

static struct net_mgmt_event_callback mgmt_cb;

static struct net_dhcpv4_option_callback dhcp_cb;

static void start_dhcpv4_client(struct net_if *iface, void *user_data)
{
	ARG_UNUSED(user_data);

	LOG_INF("Start on %s: index=%d", net_if_get_device(iface)->name,
		net_if_get_by_iface(iface));
	net_dhcpv4_start(iface);
}

static void handler(struct net_mgmt_event_callback *cb,
		    uint32_t mgmt_event,
		    struct net_if *iface)
{
	int i = 0;

	if (mgmt_event != NET_EVENT_IPV4_ADDR_ADD) {
		return;
	}

	for (i = 0; i < NET_IF_MAX_IPV4_ADDR; i++) {
		char buf[NET_IPV4_ADDR_LEN];

		if (iface->config.ip.ipv4->unicast[i].ipv4.addr_type !=
							NET_ADDR_DHCP) {
			continue;
		}

		LOG_INF("   Address[%d]: %s", net_if_get_by_iface(iface),
			net_addr_ntop(AF_INET,
			    &iface->config.ip.ipv4->unicast[i].ipv4.address.in_addr,
						  buf, sizeof(buf)));
		LOG_INF("    Subnet[%d]: %s", net_if_get_by_iface(iface),
			net_addr_ntop(AF_INET,
				       &iface->config.ip.ipv4->unicast[i].netmask,
				       buf, sizeof(buf)));
		LOG_INF("    Router[%d]: %s", net_if_get_by_iface(iface),
			net_addr_ntop(AF_INET,
						 &iface->config.ip.ipv4->gw,
						 buf, sizeof(buf)));
		LOG_INF("Lease time[%d]: %u seconds", net_if_get_by_iface(iface),
			iface->config.dhcpv4.lease_time);
	}
}

static void option_handler(struct net_dhcpv4_option_callback *cb,
			   size_t length,
			   enum net_dhcpv4_msg_type msg_type,
			   struct net_if *iface)
{
	char buf[NET_IPV4_ADDR_LEN];

	LOG_INF("DHCP Option %d: %s", cb->option,
		net_addr_ntop(AF_INET, cb->data, buf, sizeof(buf)));
}

void init_dhcp()
{
	LOG_INF("Run dhcpv4 client");

	net_mgmt_init_event_callback(&mgmt_cb, handler,
				     NET_EVENT_IPV4_ADDR_ADD);
	net_mgmt_add_event_callback(&mgmt_cb);

	net_dhcpv4_init_option_callback(&dhcp_cb, option_handler,
					DHCP_OPTION_NTP, ntp_server,
					sizeof(ntp_server));

	net_dhcpv4_add_option_callback(&dhcp_cb);

	net_if_foreach(start_dhcpv4_client, NULL);
}
```
